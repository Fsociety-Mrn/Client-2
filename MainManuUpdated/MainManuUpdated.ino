#include "U8glib.h"
#include <ClickEncoder.h>
#include <TimerOne.h>

U8GLIB_SSD1306_128X64 u8g(U8G_I2C_OPT_DEV_0 | U8G_I2C_OPT_NO_ACK | U8G_I2C_OPT_FAST); // Fast I2C / TWI

// all the arrays below are generated from images using image2cpp website
// scroll down to see the actual code

// ' Day_Mode', 16x16px
const unsigned char bitmap__Day_Mode [] PROGMEM = {
	0x00, 0x00, 0x01, 0x80, 0x2b, 0xd4, 0x18, 0x18, 0x33, 0xcc, 0x07, 0xe0, 0x0f, 0xf0, 0x2f, 0xf4, 
	0x6f, 0xf6, 0x2f, 0xf4, 0x0f, 0xf0, 0x07, 0xe0, 0x33, 0xcc, 0x18, 0x18, 0x2b, 0xd4, 0x01, 0x80
};
// ' Night_Mode', 16x16px
const unsigned char bitmap__Night_Mode [] PROGMEM = {
	0x00, 0x05, 0x20, 0x02, 0x07, 0xe5, 0x4f, 0xf0, 0x1f, 0x0a, 0x3e, 0x00, 0x3c, 0x40, 0x3c, 0x04, 
	0x3c, 0x00, 0x3e, 0x00, 0x1f, 0x08, 0x0f, 0xf0, 0x27, 0xe0, 0x70, 0x02, 0x20, 0x08, 0x00, 0x00
};
// ' RainMode_Icon', 16x16px
const unsigned char bitmap__RainMode_Icon [] PROGMEM = {
	0x44, 0x14, 0x11, 0x80, 0x43, 0xca, 0x0f, 0xb0, 0x3f, 0xfc, 0x7f, 0xf6, 0x7f, 0xfe, 0x6f, 0xf4, 
	0x04, 0xa0, 0x00, 0x80, 0x50, 0x8a, 0x04, 0x80, 0x44, 0x88, 0x03, 0x00, 0x00, 0x00, 0x00, 0x00
};
// ' Settings_Icon', 16x16px
const unsigned char bitmap__Settings_Icon [] PROGMEM = {
	0x00, 0x00, 0x03, 0xc0, 0x1b, 0xd8, 0x3f, 0xfc, 0x3f, 0xfc, 0x1f, 0xf8, 0x3e, 0x7c, 0x7c, 0x3e, 
	0x7c, 0x3e, 0x3e, 0x7c, 0x1f, 0xf8, 0x3f, 0xfc, 0x3f, 0xfc, 0x1b, 0xd8, 0x03, 0xc0, 0x00, 0x00
};
// ' SOS_Icon', 16x16px
const unsigned char bitmap__SOS_Icon [] PROGMEM = {
	0x00, 0x00, 0x1c, 0x00, 0x36, 0x7c, 0x23, 0x02, 0x21, 0x71, 0x26, 0x09, 0x24, 0x65, 0x24, 0x15, 
	0x26, 0x15, 0x11, 0x01, 0x18, 0x98, 0x0c, 0x6c, 0x06, 0x04, 0x03, 0x04, 0x00, 0xfc, 0x00, 0x00
};
// ' TimeCheck_Icon', 16x16px
const unsigned char bitmap__TimeCheck_Icon [] PROGMEM = {
	0x07, 0xe0, 0x18, 0x18, 0x22, 0xa4, 0x50, 0x02, 0x48, 0x0a, 0x84, 0x01, 0xa3, 0x89, 0x82, 0x41, 
	0xa2, 0x49, 0x81, 0x81, 0xa0, 0x09, 0x50, 0x02, 0x47, 0xe2, 0x23, 0xc4, 0x18, 0x18, 0x07, 0xe0
};

// Array of all bitmaps for convenience. (Total bytes used to store images in PROGMEM = 384)
const unsigned char* bitmap_icons[6] = {
	bitmap__Day_Mode,
	bitmap__Night_Mode,
	bitmap__RainMode_Icon,
	bitmap__SOS_Icon,
	bitmap__Settings_Icon,
	bitmap__TimeCheck_Icon
};


// 'scrollbar_background', 8x64px
const unsigned char bitmap_scrollbar_background [] PROGMEM = {
  0x00, 0x02, 0x00, 0x02, 0x00, 0x02, 0x00, 0x02, 0x00, 0x02, 0x00, 0x02, 0x00, 0x02, 0x00, 0x02, 
  0x00, 0x02, 0x00, 0x02, 0x00, 0x02, 0x00, 0x02, 0x00, 0x02, 0x00, 0x02, 0x00, 0x02, 0x00, 0x02, 
  0x00, 0x02, 0x00, 0x02, 0x00, 0x02, 0x00, 0x02, 0x00, 0x02, 0x00, 0x02, 0x00, 0x02, 0x00, 0x02, 
  0x00, 0x02, 0x00, 0x02, 0x00, 0x02, 0x00, 0x02, 0x00, 0x02, 0x00, 0x02, 0x00, 0x02, 0x00, 0x00
};

// 'item_sel_outline', 128x21px
const unsigned char bitmap_item_sel_outline [] PROGMEM = {
  0x1f, 0xff, 0xff, 0xff, 0xff, 0xff, 0xff, 0xff, 0xff, 0xff, 0xff, 0xff, 0xff, 0xff, 0xff, 0xc0, 
  0x20, 0x00, 0x00, 0x00, 0x00, 0x00, 0x00, 0x00, 0x00, 0x00, 0x00, 0x00, 0x00, 0x00, 0x00, 0x20, 
  0x40, 0x00, 0x00, 0x00, 0x00, 0x00, 0x00, 0x00, 0x00, 0x00, 0x00, 0x00, 0x00, 0x00, 0x00, 0x30, 
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  0x1f, 0xff, 0xff, 0xff, 0xff, 0xff, 0xff, 0xff, 0xff, 0xff, 0xff, 0xff, 0xff, 0xff, 0xff, 0xc0
};



// ------------------ end generated bitmaps from image2cpp ---------------------------------



const int NUM_ITEMS = 6; // number of items in the list and also the number of screenshots and screenshots with QR codes (other screens)
const int MAX_ITEM_LENGTH = 20; // maximum characters for the item name

char menu_items [NUM_ITEMS] [MAX_ITEM_LENGTH] = {  // array with item names
  { "Day Mode" }, 
  { "Night Mode" }, 
  { "Rain Mode" }, 
  { "SOS Mode" }, 
  { "Settings" }, 
  { "Time Check" },  
 };

const int NUM_ITEMS_SCREEN2 = 6; // number of items in the list and also the number of screenshots and screenshots with QR codes (other screens)
const int MAX_ITEM_LENGTH_SCREEN2 = 30; // maximum characters for the item name

char menu_items_SCREEN2 [NUM_ITEMS_SCREEN2] [MAX_ITEM_LENGTH_SCREEN2] = {  // array with item names
  { "Day Mode On!!" }, 
  { "Night Mode On!!" }, 
  { "Rain Mode On!!" }, 
  { "SOS Mode On!!" }, 
  { "Settings On!!" }, 
  { "Time Check!!" },  
 };

boolean up = false;
boolean down = false;
boolean middle = false;

ClickEncoder *encoder;
int16_t last, value;

int item_selected = 0; // which item in the menu is selected

int item_sel_previous; // previous item - used in the menu screen to draw the item before the selected one
int item_sel_next; // next item - used in the menu screen to draw next item after the selected one

int current_screen = 0;   // 0 = menu, 1 = screenshot, 2 = qr

//variables for keeping track of the current and previous time for buttons
unsigned long currentMillisBtn = 0; //current time
unsigned long previousMillisBtn = 0; //previous time used to reset options
unsigned long previousMillisBtn2 = 0; //previous time used to reset selectedFunction if the modifications are not applied
int delayForResetAll = 1500;  //delay for holding the buttons to reset currentFunction and selectedFunction
int delayForResetSelectedFunction = 10000; //delay for reseting selectedFunction if it was not applied

// ------------------ end of Rotary and OLED Initilization ---------------------------------



void setup() {
  u8g.setColorIndex(1);  // set the color to white

  encoder = new ClickEncoder(A1, A0, A2);
  encoder->setAccelerationEnabled(false);

  Timer1.initialize(500);
  Timer1.attachInterrupt(timerIsr); 

  last = encoder->getValue();

// ------------------ end of Rotary and OLED Initilization ---------------------------------  


}


void loop() {    


  u8g.firstPage(); // required for page drawing mode for u8g library
  do {

    if (current_screen == 0) { // MENU SCREEN

      // selected item background
      u8g.drawBitmapP(0, 22, 128/8, 21, bitmap_item_sel_outline);

      // draw previous item as icon + label
      u8g.setFont(u8g_font_7x14);
      u8g.drawStr(25, 15, menu_items[item_sel_previous]); 
      u8g.drawBitmapP( 4, 2, 16/8, 16, bitmap_icons[item_sel_previous]);          

      // draw selected item as icon + label in bold font
      u8g.setFont(u8g_font_7x14B);    
      u8g.drawStr(25, 15+20+2, menu_items[item_selected]);   
      u8g.drawBitmapP( 4, 24, 16/8, 16, bitmap_icons[item_selected]);     

      // draw next item as icon + label
      u8g.setFont(u8g_font_7x14);     
      u8g.drawStr(25, 15+20+20+2+2, menu_items[item_sel_next]);   
      u8g.drawBitmapP( 4, 46, 16/8, 16, bitmap_icons[item_sel_next]);  

      // draw scrollbar background
      u8g.drawBitmapP(128-8, 0, 8/8, 64, bitmap_scrollbar_background);

      // draw scrollbar handle
      u8g.drawBox(125, 64/NUM_ITEMS * item_selected, 3, 64/NUM_ITEMS); 

              

    } 
    else if (current_screen == 1) { // SCREENSHOTS SCREEN

        u8g.setFont(u8g_font_7x14B);     
        u8g.drawStr(20, 37, menu_items_SCREEN2[item_selected]);   
        
    } 
   

  } while ( u8g.nextPage() ); // required for page drawing mode with u8g library
 
  readRotaryEncoder();

   ClickEncoder::Button b = encoder->getButton();
   if (b != ClickEncoder::Open) {
   switch (b) {
      case ClickEncoder::Clicked:
         middle=true;
        break;
    }
  }   

if (up && current_screen == 0) { // MENU SCREEN
      
      up = false;
    
        item_selected = item_selected - 1; // select previous item

        if (item_selected < 0) { // if first item was selected, jump to last item
            item_selected = NUM_ITEMS-1;
          }
      }

if (down && current_screen == 0){
        down = false;
       item_selected = item_selected + 1; // select next item
          if (item_selected >= NUM_ITEMS) { // last item was selected, jump to first menu item
            item_selected = 0;
            }
      }
        
if (middle){
     middle = false;
    if (current_screen == 0) {current_screen = 1;} //
    else if (current_screen == 1) {current_screen = 0;} // screenshots screen --> Normal Screen
    
  }   
        

  // set correct values for the previous and next items
  item_sel_previous = item_selected - 1;
  if (item_sel_previous < 0) {item_sel_previous = NUM_ITEMS - 1;} // previous item would be below first = make it the last
  item_sel_next = item_selected + 1;  
  if (item_sel_next >= NUM_ITEMS) {item_sel_next = 0;} // next item would be after last = make it the first
 
 
}

void timerIsr() {
  encoder->service();
}

void readRotaryEncoder()
{
  value += encoder->getValue();
  
  if (value/2 > last) {
    last = value/2;
    down = true;
    delay(150);
  }else   if (value/2 < last) {
    last = value/2;
    up = true;
    delay(150);
  }
}

